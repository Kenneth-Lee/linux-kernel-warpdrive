## drivers/crypto/hisilicon/Kconfig
```kconfig
# SPDX-License-Identifier: GPL-2.0
config CRYPTO_DEV_HISILICON
	tristate "Support for HISILICON CRYPTO ACCELERATOR"
	help
	  Enable this to use Hisilicon Hardware Accelerators

config CRYPTO_DEV_HISI_SEC
	tristate "Support for Hisilicon SEC crypto block cipher accelerator"
	select CRYPTO_BLKCIPHER
	select CRYPTO_ALGAPI
	select SG_SPLIT
	depends on ARM64 || COMPILE_TEST
	depends on HAS_IOMEM
	help
	  Support for Hisilicon SEC Engine in Hip06 and Hip07

	  To compile this as a module, choose M here: the module
	  will be called hisi_sec.

config CRYPTO_DEV_HISI_SDMDEV
	bool "Enable SDMDEV interface"
	depends on CRYPTO_DEV_HISILICON
	select VFIO_SDMDEV
	help
	  Enable this enable the SDMDEV, "shared IOMMU Domain Mediated Device"
	  interface for all Hisilicon accelerators if they can. The SDMDEV
	  enable the WarpDrive user space accelerator driver to access the
	  hardware function directly.

config CRYPTO_DEV_HISI_QM
	tristate
	depends on ARM64 && PCI

config CRYPTO_DEV_HISI_ZIP
	tristate "Support for HISI ZIP Driver"
	depends on ARM64 && CRYPTO_DEV_HISILICON
	select CRYPTO_DEV_HISI_QM
	help
	  Support for HiSilicon HIP08 ZIP Driver
```

## drivers/uacce/Kconfig
```kconfig
menuconfig UACCE
	tristate "Accelerator Framework for User Land"
	depends on IOMMU_API
	select ANON_INODES
	help
	  UACCE provides interface for the user process to access the hardware
	  without interaction with the kernel space in data path.

	  See Documentation/warpdrive/warpdrive.rst for more details.

	  If you don't know what to do here, say N.
```

## drivers/vfio/sdmdev/Kconfig
```kconfig
# SPDX-License-Identifier: GPL-2.0
config VFIO_SDMDEV
	tristate "Support for Share Domain MDEV"
	depends on VFIO_MDEV_DEVICE
	help
	  Support for VFIO Share Domain MDEV, which enables the kernel to
	  support light weight hardware accelerator framework, WarpDrive.

	  To compile this as a module, choose M here: the module will be called
	  sdmdev.

config WD_DUMMY_DEV
	tristate "Support for WrapDrive Dummy Device"
	depends on VFIO_SDMDEV
	select VFIO_NOIOMMU
	help
	  Support for WarpDrive test driver with devices (NOT for upstream)

config WD_DUMMY_DEV_DMA_BUF
	bool "Use DMA BUF mode in WrapDrive Dummy Device"
	depends on WD_DUMMY_DEV
	select CONFIG_DMA_SHARED_BUFFER
	help
	  Support for WarpDrive test driver with devices (NOT for upstream)
```

## drivers/vfio/spimdev/Kconfig
```kconfig
# SPDX-License-Identifier: GPL-2.0
config VFIO_SPIMDEV
	tristate "Support for Share Parent IOMMU MDEV"
	depends on VFIO_MDEV_DEVICE
	help
	  Support for VFIO Share Parent IOMMU MDEV, which enables the kernel to
	  support light weight hardware accelerator framework, WarpDrive.

	  To compile this as a module, choose M here: the module will be called
	  spimdev.
```

## drivers/vfio/wdev/Kconfig
```kconfig
config VFIO_WDEV
	tristate "Support for Waradrive Framework"
	depends on VFIO_MDEV_DEVICE
	help
	  Support for WarpDrive Framework

	  To compile this as a module, choose M here: the module
	  will be called vfio_wdev.
```
